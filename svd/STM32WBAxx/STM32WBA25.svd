# STM32WBA25 register map
File version: 1.0
CPU: CM33 r0p1, little endian, MPU, FPU, 4 interrupt priority bits
Registers are 32-bit, read-write, reset 0x0 unless marked. A register's access mark holds for its fields unless they carry their own. Offsets are from the block's base; lines under a group give offsets from that group; [hi:lo] are bit positions; {n}, {i} and the like mark numbered series; 'fields as' and 'values as' point back to an identical list; <NAME> marks a mode.

## Memory map
0x40000000 TIM2 size 0x3E4 — TIM2 address block description
0x40003000 IWDG size 0x18 — IWDG address block description
0x40005400 I2C1 size 0x30 — I2C1 address block description
0x40009400 LPTIM2 size 0x38 — LPTIM2 address block description
0x40013800 USART1 size 0x34 — USART1 address block description
0x40014400 TIM16 size 0x3E4 — TIM16 address block description
0x40014800 TIM17 size 0x3E4 — TIM17 address block description
0x40015400 SAI1 size 0x400 — SAI1 register block
0x40016000 USB size 0x440 — USB address block description
0x40016400 USBSRAM size 0x440
0x40020000 LPDMA1 size 0x1000 — LPDMA1 register block
0x40022000 FLASH size 0x134 — FLASH address block description
0x40023000 CRC size 0x18 — CRC address block description
0x40026000 RAMCFG size 0x6C — RAMCFG address block description
0x40030400 ICACHE size 0x400 — ICACHE register block
0x40032400 GTZC1_TZSC size 0x50 — GTZC1_TZSC address block description
0x40032800 GTZC1_TZIC size 0x210 — GTZC1_TZIC address block description
0x40032C00 GTZC1_MPCBB1 size 0x210 — GTZC1_MPCBB1 address block description
0x40033000 GTZC1_MPCBB2 size 0x208 — GTZC1_MPCBB2 address block description
0x42020000 GPIOA size 0x34 — GPIOA address block description
0x42020400 GPIOB size 0x34 — GPIOB address block description
0x42020800 GPIOC size 0x34 — GPIOC address block description
0x42021C00 GPIOH size 0x34 — GPIOH address block description
0x420C0000 AES size 0x400 — AES register block
0x420C0400 HASH size 0x330 — HASH address block description
0x420C0800 RNG size 0x20 — RNG address block description
0x420C2000 PKA size 0x2000 — PKA register blank and RAM
0x420C5000 OTFDEC1 size 0x400 — OTFDEC register bank
0x420CF000 DLYBXS1 size 0x8 — DLYB address block description
0x420D1400 XSPI1 size 0x400 — XSPI1 register block
0x46000400 SYSCFG size 0x114 — SYSCFG address block description
0x46002000 SPI3 size 0x50 — SPI address block description
0x46002400 LPUART1 size 0x34 — LPUART1 address block description
0x46002800 I2C3 size 0x30
0x46004400 LPTIM1 size 0x38 — LPTIM1 address block description
0x46007800 RTC size 0x400 — RTC register block
0x46007C00 TAMP size 0x400 — TAMP register block
0x46020800 PWR size 0x108 — PWR address block description
0x46020C00 RCC size 0x224 — RCC address block description
0x46021000 ADC4 size 0x30C — ADC4 address block description
0x46022000 EXTI size 0x88 — EXTI address block description
0x48038000 PTACONV size 0x400 — PTACONV register block
0x50000000 SEC_TIM2 size 0x3E4
0x50003000 SEC_IWDG size 0x18
0x50005400 SEC_I2C1 size 0x30
0x50009400 SEC_LPTIM2 size 0x38
0x50013800 SEC_USART1 size 0x34
0x50014400 SEC_TIM16 size 0x3E4
0x50014800 SEC_TIM17 size 0x3E4
0x50015400 SEC_SAI1 size 0x400
0x50016000 SEC_USB size 0x440
0x50016400 SEC_USBSRAM size 0x440
0x50020000 SEC_LPDMA1 size 0x1000
0x50022000 SEC_FLASH size 0x134
0x50023000 SEC_CRC size 0x18
0x50026000 SEC_RAMCFG size 0x6C
0x50030400 SEC_ICACHE size 0x400
0x50032400 SEC_GTZC1_TZSC size 0x50
0x50032800 SEC_GTZC1_TZIC size 0x210
0x50032C00 SEC_GTZC1_MPCBB1 size 0x210
0x50033000 SEC_GTZC1_MPCBB2 size 0x208
0x52020000 SEC_GPIOA size 0x34
0x52020400 SEC_GPIOB size 0x34
0x52020800 SEC_GPIOC size 0x34
0x52021C00 SEC_GPIOH size 0x34
0x520C0000 SEC_AES size 0x400
0x520C0400 SEC_HASH size 0x330
0x520C0800 SEC_RNG size 0x20
0x520C2000 SEC_PKA size 0x2000
0x520C5000 SEC_OTFDEC1 size 0x400
0x520CF000 SEC_DLYBXS1 size 0x8
0x520D1400 SEC_XSPI1 size 0x400
0x56000400 SEC_SYSCFG size 0x114
0x56002000 SEC_SPI3 size 0x50
0x56002400 SEC_LPUART1 size 0x34
0x56002800 SEC_I2C3 size 0x30
0x56004400 SEC_LPTIM1 size 0x38
0x56007800 SEC_RTC size 0x400
0x56007C00 SEC_TAMP size 0x400
0x56020800 SEC_PWR size 0x108
0x56020C00 SEC_RCC size 0x224
0x56021000 SEC_ADC4 size 0x30C
0x56022000 SEC_EXTI size 0x88
0x58038000 SEC_PTACONV size 0x400
0xE0044000 DBGMCU size 0x1000 — DBGMCU address block description

## Interrupts
1 PVD_AVD (EXTI) — EXTI Line 16 interrupt Power Voltage Monitor/Analog Voltage Monitor
2 RTC — RTC global non-secure interrupt
3 RTC_S (SEC_RTC) — RTC global secure interrupt
4 TAMP — Tamper global interrupt
5 RAMCFG — RAM configutration CID0 global interrupt
6 Flash (FLASH) — Flash non-secure global interrupt Flash ECC single error correction interrupt
7 GTZC_TZIC (GTZC1_TZIC) — GTZC_TZIC global illegal access interrupt
8 Flash_S (SEC_FLASH) — Flash secure global interrupt
9 RCC — RCC non-secure global interrupt
10 RCC_S (SEC_RCC) — RCC secure global interrupt
{n+11} EXTI{n} (EXTI) (n=1..15) — EXTI Line{n} interrupt through EXTI[{n}]
27 IWDG — Independent watchdog interrupt
{n+28} LPDMA1_CH{n} (LPDMA1) (n=0..7) — LPDMA1 channel {n} interrupt
36 OTFDEC1 — OTFDEC1 global interrupt
40 TIM2 — TIM2 global interrupt
41 I2C1_EV (I2C1) — I2C1 event interrupt
42 I2C1_ER (I2C1) — I2C1 error interrupt
43 USART1 — USART1 global interrupt
44 LPUART1 — LPUART1 global interrupt
45 LPTIM1 — LPTIM1 global interrupt
46 LPTIM2 — LPTIM2 global interrupt
47 TIM16 — TIM16 global interrupt
48 TIM17 — TIM17 global interrupt
49 I2C3_EV (I2C3) — I2C3 event interrupt
50 I2C3_ER (I2C3) — I2C3 error interrupt
51 SAI1 — SAI1 global interrupt
52 AES — AES global interrupt
53 RNG — True random number generator interrupt
54 FPU (EXTI) — Floating point interrupt
55 HASH — HASH global interrupt
56 PKA — PKA global interrupt
57 SPI3 — SPI3 global interrupt
58 ICACHE — Instruction cache global interrupt
59 ADC4 — ADC4 global interrupt
63 RCC_AUDIO (RCC) — RCC AUDIO synchronisation interrupt
64 USB — USB global interrupt
65 XSPI1 — XSPI1 global interrupt

## Notices in the file
Copyright (c) 2026 STMicroelectronics.
SPDX-License-Identifier: Apache-2.0
Licensed under the Apache License, Version 2.0 (the "License");
you may not use this file except in compliance with the License.
You may obtain a copy of the License at
http://www.apache.org/licenses/LICENSE-2.0
Unless required by applicable law or agreed to in writing, software
distributed under the License is distributed on an "AS IS" BASIS,
WITHOUT WARRANTIES OR CONDITIONS OF ANY KIND, either express or implied.
See the License for the specific language governing permissions and
limitations under the License.
